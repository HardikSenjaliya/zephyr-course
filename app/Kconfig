## app/Kconfig
```kconfig
menuconfig LED_SUBSYSTEM
    bool "LED Subsystem"
    default y
    help
      Enable the LED subsystem.

if LED_SUBSYSTEM

choice LED_BLINK_SLEEP_TIME
    prompt "LED blink sleep time"
    default LED_BLINK_SLEEP_1S

config LED_BLINK_SLEEP_250MS
    bool "250ms"

config LED_BLINK_SLEEP_500MS
    bool "500ms"

config LED_BLINK_SLEEP_1S
    bool "1s"

config LED_BLINK_SLEEP_2S
    bool "2s"

endchoice


config LED_BLINK_SLEEP_MS
    int
    default 250 if LED_BLINK_SLEEP_250MS
    default 500 if LED_BLINK_SLEEP_500MS
    default 1000 if LED_BLINK_SLEEP_1S
    default 2000 if LED_BLINK_SLEEP_2S


menuconfig LED_ADVANCED
    bool "Advanced LED settings"
    default n


menu "Expert settings"

visible if LED_ADVANCED

config LED_BRIGHTNESS
    int "LED brightness"
    range 0 100
    default 100

config LED_FADE_DURATION
    int "LED fade duration (ms)"
    range 0 5000
    default 500

config LED_DEBUG
    bool "Enable LED debugging"
    default n

config LED_CUSTOM_PATTERN
    bool "Custom blink pattern"
    default n

endmenu

endif # LED_SUBSYSTEM
source "Kconfig.zephyr"
```

## app/blinky/Kconfig
```kconfig
config APP_HEARTBEAT_PERIOD_MS
    int "APP heartbeat period (ms)"
    range 100 2000
    default 500
    
source "Kconfig.zephyr"
```

## app/boards/our_steval_stwinbx1/board.yml
```yaml
board:
  name: our_steval_stwinbx1
  full_name: Our STEVAL STWINBX1 Development kit
  vendor: st
  socs:
    - name: stm32u585xx
```

## boards/my_board/Kconfig.defconfig
```kconfig
if BOARD_MY_BOARD
source "boards/common/usb/Kconfig.cdc_acm_serial.defconfig"
endif # BOARD_MY_BOARD
```

## boards/my_board/board.yml
```yaml
board:
  name: my_board
  full_name: My STEVAL STWINBX1 From Scratch
  vendor: custom
  socs:
    - name: stm32u585xx
```

## boards/my_board/my_board_defconfig
```kconfig
CONFIG_ARM_MPU=y

CONFIG_GPIO=y
CONFIG_GPIO_HOGS=y

CONFIG_SERIAL=y
CONFIG_CONSOLE=y
```

## modules/drivers/our_driver/Kconfig
```kconfig
config OUR_DRIVER
    bool "Enable our custom driver"
    default y
    depends on SENSOR
```

## modules/dts/bindings/our,driver.yaml
```yaml
description: |
  Group of custom LEDs.

  Each LED is defined in a child node of the custom-leds node.

compatible: "our,driver"

properties:
  gpios:
    type: phandle-array
    required: true
      
```
